## Documentation/devicetree/bindings/arm/ambarella.yaml
```yaml
# SPDX-License-Identifier: GPL-2.0-only OR BSD-2-Clause
%YAML 1.2
---
$id: http://devicetree.org/schemas/arm/ambarella.yaml#
$schema: http://devicetree.org/meta-schemas/core.yaml#

title: Ambarella SoC platforms

maintainers:
  - Long Zhao <longzhao@ambarella.com>

properties:
  $nodename:
    const: "/"

  compatible:
    oneOf:
      - description: Ambarella CV75 boards
        items:
          - enum:
              - ambarella,cv75-evk
          - const: ambarella,cv75

additionalProperties: true
```

## Documentation/devicetree/bindings/clock/ambarella,cv75-rct.yaml
```yaml
# SPDX-License-Identifier: GPL-2.0-only OR BSD-2-Clause
%YAML 1.2
---
$id: http://devicetree.org/schemas/clock/ambarella,cv75-rct.yaml#
$schema: http://devicetree.org/meta-schemas/core.yaml#

title: Ambarella CV75 RCT Clock Controller

maintainers:
  - Long Zhao <longzhao@ambarella.com>

description: |
  The RCT (Reset and Clock Tree) block on the Ambarella CV75 SoC provides
  PLLs, clock muxes, dividers and soft-reset controls for on-chip
  peripherals.

  The same register region is also exposed as a syscon for other SoC
  blocks (e.g. pin drive-strength), hence the "syscon" compatible.

  Clock indices are defined in include/dt-bindings/clock/ambarella,cv75-rct.h.

properties:

  compatible:
    items:
      - const: ambarella,cv75-rct
      - const: syscon

  reg:
    maxItems: 1

  clocks:
    description: Reference crystal oscillator (typically 24 MHz)
    maxItems: 1

  clock-names:
    const: osc

  "#clock-cells":
    const: 1

  "#reset-cells":
    const: 1

required:
  - compatible
  - reg
  - clocks
  - clock-names
  - "#clock-cells"
  - "#reset-cells"

additionalProperties: false

examples:
  - |
    clock-controller@ed080000 {
        compatible = "ambarella,cv75-rct", "syscon";
        reg = <0xed080000 0x1000>;
        clocks = <&osc>;
        clock-names = "osc";
        #clock-cells = <1>;
        #reset-cells = <1>;
    };
```

## drivers/clk/ambarella/Kconfig
```kconfig
# SPDX-License-Identifier: GPL-2.0-only

config CLK_AMBARELLA_CV75
	bool "Ambarella CV75 RCT clock controller"
	depends on ARCH_AMBARELLA || COMPILE_TEST
	default ARCH_AMBARELLA
	help
	  Say Y to enable the Ambarella CV75 RCT clock controller for
	  early bring-up clocks (core PLL, AHB, APB, UART0).
```
