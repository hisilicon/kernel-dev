## drivers/net/ethernet/hisilicon/nic_drv/nic/Kconfig
```kconfig
#
# HISILICON PV660 device configuration
#

config PV660_XGMAC
       tristate "Hisilicon PhospherV660 10 Gigabit Ethernet MAC Support"
       depends on NET_VENDOR_HISILICON 
       select PHYLIB
       help
         This selects the Hisilicon the PhospherV660 XGE network device
#source "drivers/net/ethernet/hislicon/pv660"                
```

## drivers/perf/Kconfig
```kconfig
#
# Performance Monitor Drivers
#

menu "Performance monitor support"

config ARM_PMU
	depends on PERF_EVENTS && (ARM || ARM64)
	bool "ARM PMU framework"
	default y
	help
	  Say y if you want to use CPU performance monitors on ARM-based
	  systems.

config XGENE_PMU
        depends on PERF_EVENTS && ARCH_XGENE
        bool "APM X-Gene SoC PMU"
        default n
        help
          Say y if you want to use APM X-Gene SoC performance monitors.

config ARM_PMU_ACPI
	def_bool y
	depends on ARM_PMU && ACPI

config HISI_PMU
	bool "HiSilicon SoC PMU"
	depends on PERF_EVENTS && ARM64
	help
	  Enable hardware event counter support for hardware event counters
	  in Hisilicon HiP05/06/07 SoC. The hardware modules like L3C and MN
	  have hardware events and counters.

endmenu
```

## drivers/scsi/hisi_sas/Kconfig
```kconfig
config SCSI_HISI_SAS
	tristate "HiSilicon SAS"
	select SCSI_SAS_LIBSAS
	help
		This driver supports HiSilicon's SAS HBA
```

## drivers/soc/hisilicon/Kconfig
```kconfig
#
# Hisilicon SoC drivers
#
config HISI_DJTAG
	bool "Hisilicon Djtag Support"
	depends on ARCH_HISI || COMPILE_TEST
	help
	  Say y here to enable the Hisilicon Djtag support. It is
	  an independent component which connects with some other
	  components in the SoC by Debug Bus. This driver can be
	  configured to access the registers of connecting
	  components during real time debugging.
```

## drivers/vfio/pci/Kconfig
```kconfig
# SPDX-License-Identifier: GPL-2.0-only
config VFIO_PCI_CORE
	tristate "VFIO core support for PCI devices"
	depends on VFIO && PCI && EVENTFD
	depends on MMU
	select VFIO_VIRQFD
	select IRQ_BYPASS_MANAGER
	help
	  Support for the PCI VFIO bus driver.  This is required to make
	  use of PCI drivers using the VFIO framework.

	  If you don't know what to do here, say N.

config VFIO_PCI
	tristate "VFIO support for PCI devices"
	depends on VFIO_PCI_CORE
	help
	  This provides a generic PCI support using the VFIO framework.

	  If you don't know what to do here, say N.

config VFIO_PCI_VGA
	bool "VFIO PCI support for VGA devices"
	depends on VFIO_PCI_CORE && X86 && VGA_ARB
	help
	  Support for VGA extension to VFIO PCI.  This exposes an additional
	  region on VGA devices for accessing legacy VGA addresses used by
	  BIOS and generic video drivers.

	  If you don't know what to do here, say N.

config VFIO_PCI_MMAP
	depends on VFIO_PCI_CORE
	def_bool y if !S390

config VFIO_PCI_INTX
	depends on VFIO_PCI_CORE
	def_bool y if !S390

config VFIO_PCI_IGD
	bool "VFIO PCI extensions for Intel graphics (GVT-d)"
	depends on VFIO_PCI && X86
	default y
	help
	  Support for Intel IGD specific extensions to enable direct
	  assignment to virtual machines.  This includes exposing an IGD
	  specific firmware table and read-only copies of the host bridge
	  and LPC bridge config space.

	  To enable Intel IGD assignment through vfio-pci, say Y.

config MLX5_VFIO_PCI
	tristate "VFIO support for MLX5 PCI devices"
	depends on VFIO_PCI_CORE && MLX5_CORE
	help
	  This provides a generic PCI support for MLX5 devices using the VFIO
	  framework.

	  If you don't know what to do here, say N.

config HISI_ACC_VFIO_PCI
	tristate "VFIO support for HiSilicon ACC devices"
	depends on ARM64 && VFIO_PCI_CORE
	help
	  This provides generic PCI support for HiSilicon devices using the VFIO
	  framework.

	  If you don't know what to do here, say N.
```

## drivers/vfio/pci/hisilicon/Kconfig
```kconfig
# SPDX-License-Identifier: GPL-2.0-only
config HISI_ACC_VFIO_PCI
	tristate "VFIO PCI support for HiSilicon ACC devices"
	depends on (ARM64 && VFIO_PCI_CORE) || (COMPILE_TEST && 64BIT)
	depends on PCI && PCI_MSI
	depends on UACCE || UACCE=n
	depends on ACPI
	select CRYPTO_DEV_HISI_QM
	select CRYPTO_DEV_HISI_HPRE
	select CRYPTO_DEV_HISI_SEC2
	select CRYPTO_DEV_HISI_ZIP
	help
	  This provides generic PCI support for HiSilicon ACC devices
	  using the VFIO framework.

	  If you don't know what to do here, say N.
```

## drivers/vfio/platform/Kconfig
```kconfig
config VFIO_PLATFORM
	tristate "VFIO support for platform devices"
	depends on VFIO && EVENTFD && (ARM || ARM64)
	select VFIO_VIRQFD
	select IRQ_BYPASS_MANAGER
	help
	  Support for platform devices with VFIO. This is required to make
	  use of platform devices present on the system using the VFIO
	  framework.

	  If you don't know what to do here, say N.

config VFIO_AMBA
	tristate "VFIO support for AMBA devices"
	depends on VFIO_PLATFORM && ARM_AMBA
	help
	  Support for ARM AMBA devices with VFIO. This is required to make
	  use of ARM AMBA devices present on the system using the VFIO
	  framework.

	  If you don't know what to do here, say N.

config VFIO_PLATFORM_IRQ_BYPASS_DEOI
	depends on VFIO_PLATFORM
	def_bool y

source "drivers/vfio/platform/reset/Kconfig"
```

## fs/resctrl/Kconfig
```kconfig
config RESCTRL_FS
	bool "CPU Resource Control Filesystem (resctrl)"
	depends on ARCH_HAS_CPU_RESCTRL
	select KERNFS
	help
	  Resctrl is a filesystem interface to control allocation and
	  monitoring of system resources usage by the CPU.

config RESCTRL_FS_PSEUDO_LOCK
	bool
```
