## Documentation/devicetree/bindings/arm/hisilicon/djtag.txt
```
The Hisilicon Djtag is an independent component which connects with some other
components in the SoC by Debug Bus. The djtag is available in CPU and IO dies
in the chip. The djtag controls access to connecting modules of CPU and IO
dies.
The various connecting components in CPU die (like L3 cache, L3 cache PMU etc.)
are accessed by djtag during real time debugging. In IO die there are connecting
components like RSA. These components appear as devices attached to djtag bus.

Hisilicon HiP05/06/07 djtag for CPU die
Required properties:
  - compatible : The value should be as follows
	(a) "hisilicon,hip05-cpu-djtag-v1" for CPU die which use v1 hw in
	    HiP05 chipset.
	(b) "hisilicon,hip06-cpu-djtag-v1" for CPU die which use v1 hw in
	    HiP06 chipset.
	(c) "hisilicon,hip07-cpu-djtag-v2" for CPU die which use v2 hw in
	    HiP07 chipset.
  - reg : Register address and size
  - hisilicon,scl-id : The Super Cluster ID for CPU or IO die

Example 1: Djtag for CPU die in HiP07

	/* for Hisilicon HiP07 djtag for CPU Die */
	djtag0: djtag@60010000 {
		compatible = "hisilicon,hip07-cpu-djtag-v2";
		reg = <0x0 0x60010000 0x0 0x10000>;
		hisilicon,scl-id = <0x02>;

		/* All connecting components will appear as child nodes */
	};

Hisilicon HiP05/06/07 djtag for IO die
Required properties:
  - compatible : The value should be as follows
	(a) "hisilicon,hip05-io-djtag-v1" for IO die which use v1 hw in
	    HiP05 chipset.
	(c) "hisilicon,hip06-io-djtag-v2" for IO die which use v2 hw in
	    HiP06 chipset.
	(d) "hisilicon,hip07-io-djtag-v2" for IO die which use v2 hw in
	    HiP07 chipset

Example 2: Djtag for IO die in HiP05

	/* for Hisilicon HiP05 djtag for IO Die */
	djtag1: djtag@d0000000 {
		compatible = "hisilicon,hip05-io-djtag-v1";
		reg = <0x0 0xd0000000 0x0 0x10000>;
		hisilicon,scl-id = <0x01>;

		/* All connecting components will appear as child nodes */
	};
```

## Documentation/devicetree/bindings/arm/hisilicon/pmu.txt
```
Hisilicon SoC HiP05/06/07 ARMv8 PMU
===================================

The Hisilicon SoC chips like HiP05/06/07 etc. consist of various independent
system device PMUs such as L3 cache (L3C) and Miscellaneous Nodes(MN). These
PMU devices are independent and have hardware logic to gather statistics and
performance information.

HiSilicon SoC chip is encapsulated by multiple CPU and IO dies. The CPU die
is called as Super CPU cluster (SCCL) which includes 16 cpu-cores. Every SCCL
in HiP05/06/07 chips are further grouped as CPU clusters (CCL) which includes
4 cpu-cores each.
e.g. In the case of HiP05/06/07, each SCCL has 1 L3 cache and 1 MN PMU device.
The L3 cache is further grouped as 4 L3 cache banks in a SCCL.

The Hisilicon SoC PMU DT node bindings for uncore PMU devices are as below.
For PMU devices like L3 cache. MN etc. which are accessed using the djtag,
the parent node will be the djtag node of the corresponding CPU die (SCCL).

L3 cache
---------
The L3 cache is dedicated for each SCCL. Each SCCL in HiP05/06/07 chips have 4
L3 cache banks. Each L3 cache bank have separate DT nodes.

Required properties:

	- compatible : This value should be as follows
		(a) "hisilicon,hip05-pmu-l3c-v1" for v1 hw in HiP05 chipset
		(b) "hisilicon,hip06-pmu-l3c-v1" for v1 hw in HiP06 chipset
		(c) "hisilicon,hip07-pmu-l3c-v2" for v2 hw in HiP07 chipset

	- hisilicon,module-id : This property is the module identifier for djtag.
		In v1 hw, this value is 0x04 for all L3 cache instances. But
		in v2 hw, this value is unique for each L3 cache instance.

	- hisilicon,instance-id : This property will identify the L3 cache instance
		or bank in djtag. In v1 hw, this value is unique for each L3 cache
		instance. But in v2 hw, it is 0x01 for all L3 cache instances.

	*The counter overflow IRQ is not supported in v1, v2 hardware (HiP05/06/07).

Miscellaneous Node
------------------
The MN is dedicated for each SCCL and hence there are separate DT nodes for MN
for each SCCL.

Required properties:

	- compatible : This value should be as follows
		(a) "hisilicon,hip05-pmu-mn-v1" for v1 hw in HiP05 chipset
		(b) "hisilicon,hip06-pmu-mn-v1" for v1 hw in HiP06 chipset
		(c) "hisilicon,hip07-pmu-mn-v2" for v2 hw in HiP07 chipset

	- hisilicon,module-id : Module ID to input for djtag.

	*The counter overflow IRQ is not supported in v1, v2 hardware (HiP05/06/07).

Example:

	djtag0: djtag@60010000 {
		compatible = "hisilicon,hip07-cpu-djtag-v2";
		reg = <0x0 0x60010000 0x0 0x10000>;
		hisilicon,scl-id = <0x03>;

		pmul3c0 {
			compatible = "hisilicon,hip07-pmu-l3c-v2";
			hisilicon,module-id = <0x01>;
			hisilicon,instance-id = <0x01>;
		};

		pmul3c1 {
			compatible = "hisilicon,hip07-pmu-l3c-v2";
			hisilicon,module-id = <0x02>;
			hisilicon,instance-id = <0x01>;
		};

		pmul3c2 {
			compatible = "hisilicon,hip07-pmu-l3c-v2";
			hisilicon,module-id = <0x03>;
			hisilicon,instance-id = <0x01>;
		};

		pmul3c3 {
			compatible = "hisilicon,hip07-pmu-l3c-v2";
			hisilicon,module-id = <0x04>;
			hisilicon,instance-id = <0x01>;
		};

		pmumn0 {
			compatible = "hisilicon,hip07-pmu-mn-v2";
			hisilicon,module-id = <0x21>;
		};
	};
```

## Documentation/devicetree/bindings/arm/mbigen.txt
```
Hisilicon mbigen device tree bindings.
=======================================

Mbigen means: message based interrupt generator.

MBI is kind of msi interrupt only used on Non-PCI devices.

To reduce the wired interrupt number connected to GIC,
Hisilicon designed mbigen to collect and generate interrupt.


Non-pci devices can connect to mbigen and gnerate the inteerrupt
by wirtting ITS register.

The mbigen and devices connect to mbigen have the following properties:


Mbigen required properties:
-------------------------------------------
-compatible: Should be "hisilicon,mbi-gen"
-msi-parent: should specified the ITS mbigen connected
-interrupt controller: Identifies the node as an interrupt controller
- #interrupt-cells : Specifies the number of cells needed to encode an
  interrupt source. The value is 2 for now.

  The 1st cell is the interrupt number(Hwirq).This value depends on
  the Soc design.

  The 2nd cell is the interrupt trigger type, encoded as follows:
		1 = edge triggered
		4 = level triggered

- reg: Specifies the base physical address and size of the ITS
  registers.

Examples:

	mbigen_pa: interrupt-controller@4c030000 {
			compatible = "hisilicon,mbi-gen";
			msi-parent = <&its_pa>;
			interrupt-controller;
			#interrupt-cells = <2>;
			reg = <0x4c030000 0x10000>;
		};

Device connect to mbigen required properties:
----------------------------------------------------
-interrupt-parent: Specifies the mbigen node which device connected.
-interrupts:specifies the interrupt source.The first cell is hwirq num, the
  second number is trigger type.

Examples:
	usb0: ehci@a1000000 {
		compatible = "generic-ehci";
		interrupt-parent = <&mbigen_pa>;
		reg = <0xa1000000 0x10000>;
		interrupts = <20 4>;
	};
```

## Documentation/devicetree/bindings/edac/hisi-hip05-edac.txt
```
Hisi hip05 SoC EDAC node

EDAC node is defined to describe on-chip error detection and correction.
The follow error types are supported:

  memory controller	- Memory controller
  cache (L1/L2)	- Processor L1/L2 cache

The following section describes the EDAC DT node binding.

Required properties:

 compatible		: Shall be "hisi,hip05-edac-cache".
  - poll-delay-ms	: ms of delay to poll cache ECC

Example:

edaccache {
	compatible = "hisi,hip05-edac-cache";
	poll-delay-ms = <1000>;
}
```

## Documentation/devicetree/bindings/net/hisilicon-hns-mdio.txt
```
Hisilicon MDIO bus controller

Properties:
- compatible: can be one of:
	"hisilicon,hns-mdio"
	"hisilicon,mdio"
  "hisilicon,hns-mdio" is recommended to be used for hip05 and later SOCs,
  while "hisilicon,mdio" is optional for backwards compatibility only on
  hip04 Soc.
- subctrl-vbase: specify a reference to the sub-control bus base address and
  the offset of reset, clock, reset status and clock status registers, please
  refer to the example.
- reg: The base address of the MDIO bus controller register bank.
- #address-cells: Must be <1>.
- #size-cells: Must be <0>.  MDIO addresses have no size component.

Typically an MDIO bus might have several children.

Example:
	peri_c_subctrl: syscon@80000000 {
		compatible = "hisilicon,hip05-perisubc", "syscon";
		reg = < 0x0 0x80000000 0x0 0x10000>;
        };
	mdio@803c0000 {
		#address-cells = <1>;
		#size-cells = <0>;
		compatible = "hisilicon,hns-mdio","hisilicon,mdio";
		subctrl-vbase = <&peri_c_subctrl 0x338 0xa38 0x531c 0x5a1c>;
		reg = <0x0 0x803c0000 0x0 0x10000>;

		ethernet-phy@0 {
			...
			reg = <0>;
		};
	};
```

## drivers/acpi/arm64/Kconfig
```kconfig
#
# ACPI Configuration for ARM64
#

config ACPI_IORT
	bool

config ACPI_GTDT
	bool

config ACPI_AEST
	bool "ARM Error Source Table Support"
```

## drivers/crypto/hisilicon/Kconfig
```kconfig
config CRYPTO_DEV_HISILICON
	tristate "Support for Hiliscon HAC devices"
	select CRYPTO_AEAD

config CRYPTO_DEV_WD_COMMON
	depends on VFIO_MDEV_DEVICE
	tristate "Support for WrapDrive Framework"
	depends on VFIO_MDEV_DEVICE
	help
	  Support for WrapDrive Framework

	  To compile this as a module, choose M here: the module
	  will be called wd_common.

config CRYPTO_DEV_WD_DUMMY
	tristate "Support for WD Dummy Driver"
	select CRYPTO_DEV_HISILICON
	depends on CRYPTO_DEV_WD_COMMON && VFIO_NOIOMMU
	help
	  Support for WD Dummy Driver

	  To compile this as a module, choose M here: the module
	  will be called wd_dummy.

config CRYPTO_DEV_HISI_HACV1
	tristate "Support for Hisilicon HAC V1"
	select CRYPTO_DEV_HISILICON
	depends on CRYPTO_DEV_WD_COMMON && ARM64
	help
	  Support for Hisilicon HAC Engine in Hi1612 and Hi1616

	  To compile this as a module, choose M here: the module
	  will be called hisi_hacv1.

config CRYPTO_DEV_HISI_HAC_TEST
	tristate "For testing Hisilicon HAV V1"
	select CRYPTO_DEV_HISILICON
	depends on CRYPTO_DEV_HISI_HACV1
	help
	  Support for testing algorithms of HAC Enging of Hisilicon.
	  This module should not be included in releasing.

config CRYPTO_DEV_HISI_QM
	tristate "Support for HISI QM"
	select CRYPTO_DEV_HISILICON
	depends on ARM64
	help
	  Support for HiSilicon accelerator queue manager driver

config CRYPTO_DEV_HISI_ZIP
	tristate "Support for HISI ZIP Driver"
	select CRYPTO_DEV_HISILICON
	depends on CRYPTO_DEV_WD_COMMON && ARM64 && CRYPTO_DEV_HISI_QM
	help
	  Support for HiSilicon ZIP Driver

config CRYPTO_DEV_HISI_HPRE
	tristate "Support for HISI HPRE Driver"
	select CRYPTO_DEV_HISILICON
	depends on CRYPTO_DEV_WD_COMMON && ARM64 && CRYPTO_DEV_HISI_QM
	help
	  Support for HiSilicon HPRE Driver
```

## drivers/infiniband/hw/hns/Kconfig
```kconfig
config INFINIBAND_HNS
	tristate "HNS RoCE Driver"
	depends on NET_VENDOR_HISILICON
	depends on ARM64 && HNS && HNS_DSAF && HNS_ENET
	---help---
	  This is a RoCE/RDMA driver for the Hisilicon RoCE engine. The engine
	  is used in Hisilicon Hip06 and more further ICT SoC based on
	  platform device.

	  To compile this driver as a module, choose M here: the module
	  will be called hns-roce and hns-roce-hw-v1.
```

## drivers/iommu/iommufd/Kconfig
```kconfig
# SPDX-License-Identifier: GPL-2.0-only
config IOMMUFD
	tristate "IOMMU Userspace API"
	select INTERVAL_TREE
	select IOMMU_API
	default n
	help
	  Provides /dev/iommu the user API to control the IOMMU subsystem as
	  it relates to managing IO page tables that point at user space memory.

	  This would commonly be used in combination with VFIO.

	  If you don't know what to do here, say N.

config IOMMUFD_TEST
	bool "IOMMU Userspace API Test support"
	depends on IOMMUFD
	depends on RUNTIME_TESTING_MENU
	default n
	help
	  This is dangerous, do not enable unless running
	  tools/testing/selftests/iommu
```

## drivers/misc/hisi-djtag/Kconfig
```kconfig
config HISI_DJTAG
        bool "hisilicon djtag r/w interface via syscon"
	depends on ARM64
        help
          This enables support djtag r/w for some modules.
```

## drivers/misc/hisi-nmi/Kconfig
```kconfig
menu "HISI NMI Feature Test Function"

config HISI_NMI_DEMO
	bool "HISI NMI Feature Demo"
	default n
	depends on HISI_AARCH64_NMI
	help
	  Reg the NMI feature on the HISI PV660 board. To test this function,
	  the CONFIG_HISI_AARCH64_NMI Should be Enabled.

endmenu
```

## drivers/misc/uacce/Kconfig
```kconfig
config UACCE
	tristate "Accelerator Framework for User Land"
	depends on IOMMU_API
	help
	  UACCE provides interface for the user process to access the hardware
	  without interaction with the kernel space in data path.

	  The user-space interface is described in
	  include/uapi/misc/uacce.h

	  See Documentation/misc-devices/warpdrive.rst for more details.

	  If you don't know what to do here, say N.
```

## drivers/net/ethernet/hisilicon/Kconfig
```kconfig
#
# HISILICON device configuration
#

config NET_VENDOR_HISILICON
	bool "Hisilicon devices"
	default y
	depends on ARM || ARM64
	---help---
	  If you have a network (Ethernet) card belonging to this class, say Y
	  and read the Ethernet-HOWTO, available from
	  <http://www.tldp.org/docs.html#howto>.

	  Note that the answer to this question doesn't directly affect the
	  kernel: saying N will just cause the configurator to skip all
	  the questions about Hisilicon devices. If you say Y, you will be asked
	  for your specific card in the following questions.

if NET_VENDOR_HISILICON

config HIX5HD2_GMAC
	tristate "Hisilicon HIX5HD2 Family Network Device Support"
	select PHYLIB
	help
	  This selects the hix5hd2 mac family network device.

config HIP04_ETH
	tristate "HISILICON P04 Ethernet support"
	select PHYLIB
	select MARVELL_PHY
	select MFD_SYSCON
	---help---
	  If you wish to compile a kernel for a hardware with hisilicon p04 SoC and
	  want to use the internal ethernet then you should answer Y to this.

config HIP05_GMAC
	tristate "Hisilicon HIP05 Ethernet Support"
	select PHYLIB
	help
	  This selects the hip05 network device.

config HNS
	tristate "Hisilicon Network Subsystem Support (Framework)"
	---help---
	  This selects the framework support for Hisilicon network subsystem. It
	  is needed by any driver which provide hns acceleration engine or make
	  use of the engine

config HNS_DSAF
	tristate "Hisilicon HNS DSAF device Support"
	select HNS
	select HNS_MDIO
	---help---
	  This selects the DSAF network acceleration engine support. The engine
	  is used in Hisilicon P660, Hi1610 and more further ICT SoC

config HNS_MDIO
	tristate "Hisilicon HNS MDIO device Support"
	select MDIO
	---help---
	  This selects the HNS MDIO support. It is needed by HNS_DSAF to access
	  the PHY

config HNS_ENET
	tristate "Hisilicon HNS Ethernet Device Support"
	select PHYLIB
	select HNS
	---help---
	  This selects the general ethernet driver for HNS.  This module make
	  use of any HNS AE driver, such as HNS_DSAF

source "drivers/net/ethernet/hisilicon/nic_drv/Kconfig"

endif # NET_VENDOR_HISILICON
```

## drivers/net/ethernet/hisilicon/nic_drv/Kconfig
```kconfig
#
# HISILICON device configuration
#

config HI_NET_VENDOR_NIC
	tristate "Hisilicon VENDOR NIC"
	default y
	---help---
	  This open the Nic drivers.

if HI_NET_VENDOR_NIC
config HI_NET_OSAL
	tristate "Hisilicon OSAL"
	help
	  This selects the osal module.

config HI_NET_MDIO
	tristate "Hisilicon MDIO"
	select HI_NET_OSAL
	help
	  This selects the mdio module.

config HI_NET_DSAF
	tristate "Hisilicon DSAF"
	select HI_NET_MDIO
	help
	  This selects the dsaf module.

config HI_NET_MAC
	tristate "Hisilicon MAC"
	select HI_NET_DSAF
	help
	  This selects the mac module.

config HI_NET_NIC
	tristate "Hisilicon NIC"
	select HI_NET_MAC
	help
	  This selects the nic module.
endif
```
