/**
 * Huawei Ltd.
 * PhosphorV660
 */

/ {
	#address-cells = <2>;
	#size-cells = <2>;		
	pcie0: pcie@0xb0070000 {
		compatible = "hisilicon,hip05-pcie", "snps,dw-pcie";
		reg = <0 0xb0070000 0 0x10000>, <0 0xb0000000 0 0x10000>,
		      <0 0xb00c0000 0 0x10000>, <0x0 0xb8000000 0 0x10000>;
		reg-names = "rc_dbi", "subctrl", "pcs", "config";
		bus-range = <0  15>;
		msi-parent = <&its_pcie>;
		#address-cells = <3>;
		#size-cells = <2>;
		device_type = "pci";
		ranges = <0x82000000 0 0xb3010000 0x0 0xb8010000 0 0x00f00000>;
		num-lanes = <8>;
		port-id = <0>;
		dma-coherent;
		status = "disabled";
	};

	pcie1: pcie@0xb0080000 {
		compatible = "hisilicon,hip05-pcie", "snps,dw-pcie";
		reg = <0 0xb0080000 0 0x10000>, <0 0xb0000000 0 0x10000>,
		      <0 0xb00d0000 0 0x10000>, <0x220 0x00000000 0 0x1000>;
		reg-names = "rc_dbi", "subctrl", "pcs", "config";
		bus-range = <0  15>;
		msi-parent = <&its_pcie>;
		#address-cells = <3>;
		#size-cells = <2>;
		device_type = "pci";
		ranges = <0x82000000 0 0xb4100000 0x220 0x00100000 0 0x00f00000>;
		num-lanes = <8>;
		port-id = <1>;
		dma-coherent;
		status = "disabled";
	};

	pcie2: pcie@0xb0090000 {
		compatible = "hisilicon,hip05-pcie", "snps,dw-pcie";
		reg = <0 0xb0090000 0 0x10000>, <0 0xb0000000 0 0x10000>,
		      <0 0xb00e0000 0 0x10000>, <0x240 0x00000000 0 0x1000>;
		reg-names = "rc_dbi", "subctrl", "pcs", "config";
		bus-range = <16 31>;
		msi-parent = <&its_pcie>;
		#address-cells = <3>;
		#size-cells = <2>;
		device_type = "pci";
		ranges = <0x82000000 0 0xb5100000 0x240 0x00100000 0 0x00f00000>;
		num-lanes = <8>;
		port-id = <2>;
		status = "disabled";
	};
};
