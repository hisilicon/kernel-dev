pcie@0xb0080000 {
	compatible = "hisilicon,hip05-pcie", "snps,dw-pcie";
	reg = <0 0xb0080000 0 0x10000>, <0 0xb0000000 0 0x10000>,
		  <0 0xb00d0000 0 0x10000>, <0x220 0x00000000 0 0x2000>;
	reg-names = "rc_dbi", "subctrl", "pcs", "config";
	bus-range = <0  127>;
	msi-parent = <&its_pcie>;
	#address-cells = <3>;
	#size-cells = <2>;
	device_type = "pci";
	dma-coherent;
	ranges = <0x02000000 0 0xb0000000 0x220 0x00000000 0 0x10000000>;
	num-lanes = <8>;
	port-id = <1>;
	status = "ok";
};

pcie@0xb0090000 {
	compatible = "hisilicon,hip05-pcie", "snps,dw-pcie";
	reg = <0 0xb0090000 0 0x10000>, <0 0xb0000000 0 0x10000>,
		  <0 0xb00e0000 0 0x10000>, <0x240 0x00000000 0 0x2000>;
	reg-names = "rc_dbi", "subctrl", "pcs", "config";
	bus-range = <128 255>;
	msi-parent = <&its_pcie>;
	#address-cells = <3>;
	#size-cells = <2>;
	device_type = "pci";
	dma-coherent;
	ranges = <0x02000000 0 0xb0000000 0x240 0x00000000 0 0x10000000>;
	num-lanes = <8>;
	port-id = <2>;
	status = "ok";
};
