/**
 * Huawei Ltd.
 * PhosphorV660
 */

/ {
		#address-cells = <2>;
		#size-cells = <2>;		
		pcie1: pcie@0xb0080000 {
			compatible = "hisilicon,hip05-pcie", "snps,dw-pcie";
			reg =  <0 0xb0080000 0 0x10000>,<0 0xb0000000 0 0x10000>,
				  <0 0xb00d0000 0 0x10000>, <0 0xba000000 0 0x2000>;
			reg-names = "rc_dbi","subctrl",  "pcs", "config";
			bus-range = <6 10>;
			msi-parent = <&its_pcie>;
			#address-cells = <3>;
			#size-cells = <2>;
			device_type = "pci";
			dma-coherent;
			ranges = <0x82000000 0x0 0xba010000 0x0 0xba010000 0x0 0x00e00000>;
			num-lanes = <8>;
			port-id = <1>;
			status = "ok";
		};

		pcie2: pcie@0xb0090000 {
			compatible = "hisilicon,hip05-pcie", "snps,dw-pcie";
			reg = <0 0xb0090000 0 0x10000>,<0 0xb0000000 0 0x10000>,
				  <0 0xb00e0000 0 0x10000>, <0 0xbc000000 0 0x2000>;
			reg-names = "rc_dbi","subctrl", "pcs", "config";
			bus-range = <11 15>;
			msi-parent = <&its_pcie>;
			#address-cells = <3>;
			#size-cells = <2>;
			device_type = "pci";
			dma-coherent;
			ranges = <0x82000000 0x0 0xbc002000 0x0 0xbc002000 0x0 0x1ffe000>;
			num-lanes = <8>;
			port-id = <2>;
			status = "ok";
		};

};

